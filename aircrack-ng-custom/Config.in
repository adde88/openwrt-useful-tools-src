## aircrack-ng-custom/Config.in
```kconfig
if PACKAGE_aircrack-ng-custom

comment "SSL support"

choice
    prompt "Select SSL library"
    default AIRCRACK_NG_CUSTOM_OPENSSL

    config AIRCRACK_NG_CUSTOM_OPENSSL
        bool "openssl"

    config AIRCRACK_NG_CUSTOM_GCRYPT
        bool "gcrypt"
endchoice

config AIRCRACK_NG_CUSTOM_OPTIMIZE_SPEED
    bool "Optimize for speed"
    default y
    help
        This enables additional optimization and
        increases performance considerably at the
        expense of binary size.

comment "Miscellaneous"

config AIRCRACK_NG_CUSTOM_HWLOC
    bool "Hwloc support"
    default y

config AIRCRACK_NG_CUSTOM_SQLITE3
    bool "Sqlite3 support"
    default y

config AIRCRACK_NG_CUSTOM_EXPERIMENTAL
    bool "Compile additional experimental tools"
    default y

endif
```

## hostapd-wpe/Config.in
```kconfig
config WPE_RFKILL_SUPPORT
	bool "Add rfkill support"
	depends on PACKAGE_wpa-supplicant || \
		PACKAGE_wpa-supplicant-mini || \
		PACKAGE_wpad || \
		PACKAGE_wpad-mini
	default n

config WPE_MSG_MIN_PRIORITY
	int "Minimum debug message priority"
	default 2
	help
	  Useful values are:
	    0 = all messages
		1 = raw message dumps
		2 = most debugging messages
		3 = info messages
		4 = warnings
		5 = errors

config WPE_WEXT_SUPPORT
	bool
	default y

config WPE_11N_SUPPORT
        bool
        default y

config WPE_11AC_SUPPORT
        bool
        default y

config WPE_11W_SUPPORT
        bool
        default y

config WPE_TAXONOMY_SUPPORT
        bool
        default y
```
